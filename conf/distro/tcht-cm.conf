## conf/distro/tcht-cm.conf
```bitbake
# TycheTools Distro for NE Control Module.

require conf/distro/include/fslc-base.inc

DISTRO = "tcht-cm"
DISTRO_NAME = "TCHT Control Module"

# Remove conflicting backends.
DISTRO_FEATURES_remove = "x11 wayland directfb vulkan"

DISTRO_FEATURES_append = " bluetooth wifi bluez5"

DISTRO_FEATURES_remove = "pci"
DISTRO_FEATURES_remove = "nfs"

DISTRO_FEATURES_remove = "splash"
DISTRO_FEATURES_remove = "opengl"

DISTRO_FEATURES_append = " ttgateway"
DISTRO_FEATURES_append = " ttgatewayfw"
DISTRO_FEATURES_append = " ttsnmp"
DISTRO_FEATURES_append = " ttmodbus"

DISTRO_FEATURES_append = " necm"
DISTRO_FEATURES_append = " cmdisplay"

DISTRO_FEATURES_append = " gpiomodule"
```

## conf/distro/tcht-gateway.conf
```bitbake
# TycheTools Distro for Gateway.

require conf/distro/include/fslc-base.inc

DISTRO = "tcht-gateway"
DISTRO_NAME = "TCHT Gateway"

# Remove conflicting backends.
DISTRO_FEATURES_remove = "x11 wayland directfb vulkan"

DISTRO_FEATURES_append = " bluetooth wifi bluez5"

DISTRO_FEATURES_remove = "pci"
DISTRO_FEATURES_remove = "nfs"

DISTRO_FEATURES_remove = "splash"
DISTRO_FEATURES_remove = "opengl"

DISTRO_FEATURES_append = " ttgateway"
DISTRO_FEATURES_append = " ttgatewayfw"
DISTRO_FEATURES_append = " ttble"
DISTRO_FEATURES_append = " ttsnmp"

DISTRO_FEATURES_append = " tt4g"
DISTRO_FEATURES_append = " gpiomodule"
DISTRO_FEATURES_append = " usbautorun"
DISTRO_FEATURES_append = " ttdiagnosis"
```

## conf/layer.conf
```bitbake
# We have a conf and classes directory, add to BBPATH
BBPATH .= ":${LAYERDIR}"

# We have recipes-* directories, add to BBFILES
BBFILES += "${LAYERDIR}/recipes-*/*/*.bb \
            ${LAYERDIR}/recipes-*/*/*.bbappend"

BBFILE_COLLECTIONS += "heimdall"
BBFILE_PATTERN_heimdall = "^${LAYERDIR}/"
BBFILE_PRIORITY_heimdall = "10"

LAYERDEPENDS_heimdall = "variscite-fslc"
LAYERSERIES_COMPAT_heimdall = "dunfell"

BBFILES_DYNAMIC += " \
    swupdate:${LAYERDIR}/dynamic-layers/swupdate/*.bb \
    swupdate:${LAYERDIR}/dynamic-layers/swupdate/*.bbappend \
"
```
